## drivers/power/rt9426a_fg_mmi/Kconfig
```kconfig
config RT9426A_FG_MMI
    tristate "RT9426A FGADC Device Driver V1.0.1_G"
    default n
    help
        Say Y here if you have CW2217 FGADC Device support
        in your system.

        If unsure, say N.

        To compile this driver as a module, choose M here: the
        module will be called rt9426a_fg_mmi.
```

## drivers/regulator/ocp2138/Kconfig
```kconfig
config REGULATOR_OCP2138
    tristate "WingTech OCP2138 Panel Power Supply Driver"
    default n
    help
        Say Y here if you have OCP2138 Panel Power Supply Device support
        in your system.

        If unsure, say N.

        To compile this driver as a module, choose M here: the
        module will be called ocp2138.
```
